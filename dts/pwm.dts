/dts-v1/;
/plugin/;

/ {
	compatible = "brcm,bcm2837";

	fragment@0 {
		target = <&gpio>;
		__overlay__ {
			pwm_pins: pwm_pins {
				brcm,pins = <12 13>;           /* Moved from 18,19 → 12,13 */
				brcm,function = <4 4>;         /* Both GPIO12 + GPIO13 use ALT0 for PWM */
			};
		};
	};

	fragment@1 {
		target = <&pwm>;
		frag1: __overlay__ {
			pinctrl-names = "default";
			pinctrl-0 = <&pwm_pins>;
			status = "okay";
		};
	};

	__overrides__ {
		pin   = <&pwm_pins>,"brcm,pins:0";
		pin2  = <&pwm_pins>,"brcm,pins:4";
		func  = <&pwm_pins>,"brcm,function:0";
		func2 = <&pwm_pins>,"brcm,function:4";
		clock = <&frag1>,"assigned-clock-rates:0";
	};
};
